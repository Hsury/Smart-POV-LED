/*
 * Project Name: Smart POV LED (Full Edition)
 * Software Version: 2016/12/22
 */
#define element 1024 //1024 = 128 * 64 / 8  (2-bit HEX = 16-bit BIN)
#define ver "2016/12/22" //Version

#include <ESP8266WiFi.h>
#include <ESP8266mDNS.h>
#include <ArduinoOTA.h>
#include <ESP8266WebServer.h>
#include <WiFiUdp.h>

ADC_MODE(ADC_VCC); //Read VCC voltage
ESP8266WebServer server(80);
WiFiUDP Udp;

int rPin = 2; //Pin connected to Red pin of LED
int gPin = 4; //Pin connected to Green pin of LED
int bPin = 5; //Pin connected to Blue pin of LED
int latchPin = 12; //Pin connected to ST_CP of 74HC595
int clockPin = 13; //Pin connected to SH_CP of 74HC595
int dataPin = 14; //Pin connected to DS of 74HC595
int laserPin = 15; //Pin connected to laser receiver

const char* ssid = "My Router"; //Wi-Fi SSID
const char* password = "12345678"; //Wi-Fi Password
const char* apssid = "My POV LED"; //Soft AP SSID
const char* www_username = "pov"; //Webserver Username
const char* www_password = "led"; //Webserver Password
unsigned int localUdpPort = 4210; //Local port to listen on
char incomingPacket[UDP_TX_PACKET_MAX_SIZE]; //Buffer for incoming packets
bool homeflag = false; //Begin flag
unsigned long timestamp = 0; //Record the previous time
unsigned long cycle = 0; //Cycle number
unsigned int rpm = 600; //Rotating speed
int effectscheme = 2; //Current effect scheme
int ledscheme = 4; //Current LED scheme
int screenscheme = 0; //Current screen scheme
int commandmode = 0; //Command mode

int temp_leddata[3]; //Read-Write LED data, CAN be edited by user
unsigned char temp_screendata[element]; //Read-Write screen data, CAN be edited by user
const int saved_leddata[8][3] = //Read-only LED data, CANNOT be edited by user
{
  {255, 0, 0}, //Red
  {255, 165, 0}, //Orange
  {255, 255, 0}, //Yellow
  {0, 255, 0}, //Green
  {0, 127, 255}, //Cyan
  {0, 0, 255}, //Blue
  {139, 0, 255}, //Purple
  {255, 255, 255}, //White
};
const unsigned char saved_screendata[5][element] = //Read-only screen data, CANNOT be edited by user
{
  { //No.0 POV LED
    0xFF, 0xFF, 0xFF, 0xFF, 0xFF, 0xFF, 0xFF, 0xFF, 0xFF, 0xFF, 0xFF, 0xFF, 0xFF, 0xFF, 0xFF, 0xFF, 0xFF, 0xFF, 0xFF, 0xFF, 0xFF, 0xFF, 0xFF, 0xFF, 0xFF, 0xFF, 0xFF, 0xFF, 0xFF, 0xFF, 0xFF, 0xFF,
    0xFF, 0xFF, 0xFF, 0xFF, 0xFF, 0xFF, 0xFF, 0xFF, 0xFF, 0xFF, 0xFF, 0xFF, 0xFF, 0xFF, 0xFF, 0xFF, 0xFF, 0xFF, 0xFF, 0xFF, 0xFF, 0xFF, 0xFF, 0xFF, 0xFF, 0xFF, 0xFF, 0xFF, 0xFF, 0xFF, 0xFF, 0xFF,
    0xFF, 0xFF, 0xFF, 0xFF, 0xFF, 0xFF, 0xFF, 0xFF, 0xFF, 0xFF, 0xFF, 0xFF, 0xFF, 0xFF, 0xFF, 0xFF, 0xFF, 0xFF, 0xFF, 0xFF, 0xFF, 0xFF, 0xFF, 0xFF, 0xFF, 0xFF, 0xFF, 0xFF, 0xFF, 0xFF, 0xFF, 0xFF,
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    0xFF, 0xFF, 0xFF, 0xFF, 0xFF, 0xFF, 0xFF, 0xFF, 0xFF, 0xFF, 0xFF, 0xFF, 0xFF, 0xFF, 0xFF, 0xFF, 0xFF, 0xFF, 0xFF, 0xFF, 0xFF, 0xFF, 0xFF, 0xFF, 0xFF, 0xFF, 0xFF, 0xFF, 0xFF, 0xFF, 0xFF, 0xFF
  },
  { //No.1 UESTC LOGO
    0xFF, 0xFF, 0xFF, 0xFF, 0xFF, 0xFF, 0xFF, 0xFF, 0xFF, 0xFF, 0xFF, 0x3F, 0xFC, 0xFF, 0xFF, 0xFF, 0xFF, 0xFF, 0xFF, 0xFF, 0xFB, 0xFF, 0xFF, 0xFF, 0xFF, 0xFF, 0xFF, 0xFF, 0xFB, 0xFF, 0xFF, 0xFF,
    0xFF, 0xFF, 0xFF, 0xFF, 0xFB, 0xFF, 0xFF, 0xFF, 0xFF, 0xFF, 0x7F, 0x3C, 0xBC, 0xFE, 0xFF, 0xFF, 0xFF, 0xFF, 0x9F, 0xE1, 0x0F, 0xF9, 0xFF, 0xFF, 0xFF, 0xFF, 0xCF, 0x0F, 0xE4, 0xF7, 0xFF, 0xFF,
    0xFF, 0xFF, 0xCF, 0x1F, 0xF8, 0xE7, 0xFF, 0xFF, 0xFF, 0xFF, 0xCF, 0xCF, 0xF3, 0xE7, 0xFF, 0xFF, 0xFF, 0xFF, 0xCF, 0x4F, 0xF5, 0xE7, 0xFF, 0xFF, 0xFF, 0xFF, 0xDF, 0x4F, 0xF5, 0xF7, 0xFF, 0xFF,
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    0xFF, 0xFF, 0xFF, 0x5F, 0xFD, 0xFF, 0xFF, 0xFF, 0xFF, 0xFF, 0xFF, 0x9F, 0xFD, 0xFF, 0xFF, 0xFF, 0xFF, 0xFF, 0xFF, 0xBF, 0xFF, 0xFF, 0xFF, 0xFF, 0xFF, 0xFF, 0xFF, 0xFF, 0xFF, 0xFF, 0xFF, 0xFF
  },
  { //No.2 I Love You
    0xFC, 0xFF, 0xFF, 0xFF, 0xFF, 0xFF, 0xFF, 0x3F, 0xF0, 0xFF, 0xFF, 0xFF, 0xFF, 0xFF, 0xFF, 0x0F, 0xC0, 0xFF, 0xFF, 0xFF, 0xFF, 0xFF, 0xFF, 0x03, 0xC0, 0xFF, 0xFF, 0xFF, 0xFF, 0xFF, 0xFF, 0x03,
    0x80, 0xFF, 0xFF, 0xFF, 0xFF, 0xFF, 0xFF, 0x01, 0x00, 0xFF, 0xFF, 0xFF, 0xFF, 0xFF, 0xFF, 0x00, 0x00, 0xFF, 0xFF, 0xFF, 0xFF, 0xFF, 0xFF, 0x00, 0x00, 0xFF, 0xFF, 0xFF, 0xFF, 0xFF, 0xFF, 0x00,
    0x00, 0xFF, 0xFF, 0xFF, 0xFF, 0xFF, 0xFF, 0x00, 0x00, 0xFF, 0xFF, 0xFF, 0xFF, 0xFF, 0xFF, 0x00, 0x00, 0xFF, 0xFF, 0xFF, 0xFF, 0xFF, 0xFF, 0x00, 0x80, 0xFF, 0xFF, 0xFF, 0xFF, 0xFF, 0xFF, 0x01,
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    0xC0, 0xFF, 0xFF, 0xFF, 0xFF, 0xFF, 0xFF, 0x03, 0xC0, 0xFF, 0xFF, 0xFF, 0xFF, 0xFF, 0xFF, 0x03, 0xF0, 0xFF, 0xFF, 0xFF, 0xFF, 0xFF, 0xFF, 0x0F, 0xFC, 0xFF, 0xFF, 0xFF, 0xFF, 0xFF, 0xFF, 0x3F
  },
  { //No.3 The Elderly
    0xFC, 0xFF, 0xFF, 0xFF, 0xFF, 0xFF, 0xFF, 0x3F, 0xF9, 0xFF, 0xFF, 0xFF, 0xFF, 0xFF, 0xFF, 0xCF, 0xE7, 0xFF, 0xFF, 0xFF, 0xFF, 0xFF, 0xFF, 0xE3, 0x9F, 0xFF, 0xFF, 0xFF, 0xFF, 0xFF, 0xFF, 0xF9,
    0x3F, 0xFE, 0xFF, 0xFF, 0xFF, 0xFF, 0x7F, 0xFE, 0xFF, 0xFC, 0xFF, 0xFF, 0xFF, 0xFF, 0x1F, 0xFF, 0xFF, 0xF3, 0xFF, 0xFF, 0xFF, 0xFF, 0xCF, 0xFF, 0xFF, 0xCF, 0xFF, 0xFF, 0xFF, 0xFF, 0xF3, 0xFF,
    0xFF, 0xCF, 0xFF, 0xFF, 0xFF, 0xFF, 0xF3, 0xFF, 0xFF, 0xF3, 0x7D, 0xFF, 0xFF, 0xFF, 0xCF, 0xFF, 0xFF, 0xF8, 0xBD, 0xFF, 0xA3, 0xC3, 0x3F, 0xFF, 0x7F, 0xFE, 0x5D, 0xF0, 0xAF, 0xBB, 0x7F, 0xFC,
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    0x9F, 0xFF, 0xFF, 0xFF, 0xFF, 0xFF, 0xFF, 0xF9, 0xC7, 0xFF, 0xFF, 0xFF, 0xFF, 0xFF, 0xFF, 0xE7, 0xF3, 0xFF, 0xFF, 0xFF, 0xFF, 0xFF, 0xFF, 0x9F, 0xFC, 0xFF, 0xFF, 0xFF, 0xFF, 0xFF, 0xFF, 0x3F
  },
  { //No.4 Huaji
    0xFF, 0xFF, 0xFF, 0xFF, 0xFF, 0xFF, 0xFF, 0xFF, 0xFF, 0xFF, 0xFF, 0xFF, 0xFF, 0xFF, 0xFF, 0xFF, 0xFF, 0xFF, 0xFF, 0xFF, 0xFF, 0xFF, 0xFF, 0xFF, 0xFF, 0xFF, 0xFF, 0xFF, 0xFF, 0xFF, 0xFF, 0xFF,
    0xFF, 0xFF, 0xFF, 0xFF, 0xFF, 0xFF, 0xFF, 0xFF, 0xFF, 0xFF, 0xFF, 0xFF, 0xFF, 0xFF, 0xFF, 0xFF, 0xFF, 0xFF, 0xFF, 0xFF, 0xFF, 0xFF, 0xFF, 0xFF, 0xFF, 0xFF, 0xFF, 0xFF, 0xFF, 0xFF, 0xFF, 0xFF,
    0xFF, 0xFF, 0xFF, 0xFF, 0xFF, 0xFF, 0xFF, 0xFF, 0xFF, 0xFF, 0xFF, 0xFF, 0xFF, 0xFF, 0xFF, 0xFF, 0xFF, 0xFF, 0xFF, 0xFF, 0xFF, 0xFF, 0xFF, 0xFF, 0xFF, 0xFF, 0xFF, 0xFF, 0xFF, 0xFF, 0xFF, 0xFF,
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    0xFF, 0xFF, 0xFF, 0xFF, 0xFF, 0xFF, 0xFF, 0xFF, 0xFF, 0xFF, 0xFF, 0xFF, 0xFF, 0xFF, 0xFF, 0xFF, 0xFF, 0xFF, 0xFF, 0xFF, 0xFF, 0xFF, 0xFF, 0xFF, 0xFF, 0xFF, 0xFF, 0xFF, 0xFF, 0xFF, 0xFF, 0xFF
  }
};

void setup() {
  memset(temp_leddata, 0, 3); //Initialize the array
  memset(temp_screendata, 0xFF, element); //Initialize the array
  analogWriteRange(255); //Set PWM range
  pinMode(rPin, OUTPUT);
  pinMode(gPin, OUTPUT);
  pinMode(bPin, OUTPUT);
  pinMode(latchPin, OUTPUT);
  pinMode(clockPin, OUTPUT);
  pinMode(dataPin, OUTPUT);
  selftest(); //LED self test
  Serial.begin(115200);
  delay(10);
  Serial.println();
  Serial.println("Smart POV-LED");
  Serial.print("Version: ");
  Serial.println(ver);
  Serial.println();
  netconfig(); //Configure wireless module
  Serial.println("NOTE: You can only use the command <info> in Serial Mode");
  Serial.println("      Advanced commands are enabled in UDP Mode");
  Serial.println();
  Serial.println("System is running");
  Serial.println();
  attachInterrupt(laserPin, gethome, FALLING); //Attach interrupt
}

void loop() {
  trigger();
  if (checkstat()) {
    ledcontrol();
    screencontrol();
  }
}

void gethome() {
  if (micros() - timestamp >= 2000) {
    homeflag = true; //Mark the home flag
    rpm = 6E7 / (micros() - timestamp); //Calculate RPM
    timestamp = micros(); //Update timestamp
  }
}

void trigger() {
  ArduinoOTA.handle();
  server.handleClient();
  udphandler();
  comhandler();
}

bool checkstat() {
  if (rpm >= 600) { //Speed too low
    return true;
  } else {
    return false;
  }
}

void selftest() {
  int i;
  digitalWrite(latchPin, LOW);
  for (i = 0; i < 8; i++) {
    shiftOut(dataPin, clockPin, MSBFIRST, 0x00); //Turn on all LED
  }
  digitalWrite(latchPin, HIGH);
  analogWrite(rPin, 255); //Test Red pin
  delay(500);
  analogWrite(rPin, 0);
  analogWrite(gPin, 255); //Test Green pin
  delay(500);
  analogWrite(gPin, 0);
  analogWrite(bPin, 255); //Test Blue pin
  delay(500);
  analogWrite(bPin, 0);
}

void netconfig() {
  int i = 0;
  WiFi.persistent(false); //Turn off the Persistent Mode
  WiFi.mode(WIFI_STA); //Set the working mode of ESP-8266 to Station
  WiFi.begin(ssid, password); //Try to connect to Wi-Fi
  Serial.printf("Trying to connect to %s\n", ssid);
  for (i = 1; i <= 100; i++) { //Try for 10 seconds
    delay(100);
    if (WiFi.status() != WL_CONNECTED) { //Detect the connecting status
      Serial.print(">");
    } else {
      break;
    }
  }
  Serial.println();
  if (WiFi.status() != WL_CONNECTED) { //Cannot connect to Wi-Fi, then start SoftAP
    Serial.println("Failed");
    WiFi.mode(WIFI_AP); //Set the working mode of ESP-8266 to SoftAP
    WiFi.softAP(apssid); //Create an Open AP
    Serial.println();
    Serial.println("SoftAP has launched");
    Serial.printf("SSID: %s\n", apssid);
    Serial.println();
    Serial.printf("IP Address: %s\n", WiFi.softAPIP().toString().c_str()); //Print IP at SoftAP Mode
  } else {
    Serial.println("Succeeded");
    Serial.println();
    Serial.printf("IP Address: %s\n", WiFi.localIP().toString().c_str()); //Print IP at Station Mode
  }
  ArduinoOTA.begin();
  server.on("/", []() {
    if (!server.authenticate(www_username, www_password))
      return server.requestAuthentication();
    infomaker(0);
  });
  server.begin();
  Udp.begin(localUdpPort);
  Serial.println("Wed Server Port: 80");
  Serial.printf("UDP Port: %d\n", localUdpPort);
  Serial.println();
}

void udphandler() {
  int packetSize = Udp.parsePacket();
  if (packetSize) //Receive incoming UDP packets
  {
    int len = Udp.read(incomingPacket, UDP_TX_PACKET_MAX_SIZE);
    if (len > 0)
    {
      incomingPacket[len] = 0;
    }
    String command(incomingPacket);
    String message = "";
    char tmp[3];
    int i, j;
    switch (commandmode) {
      case 0: //Root
        if (command == "info") { //Get the information
          infomaker(2);
        }
        if (command == "reset") { //Restart the ESP-8266
          ESP.restart();
        }
        if (command == "effect") { //Set the effect scheme
          commandmode = 1;
          message += "Effect Scheme Number (0-13) =\n";
        }
        if (command == "led") { //Set the LED scheme
          commandmode = 2;
          message += "LED Scheme Number (0-8) =\n";
        }
        if (command == "screen") { //Set the screen scheme
          commandmode = 3;
          message += "Screen Scheme Number (0-5) =\n";
        }
        if (command == "lededit") { //Edit the LED scheme
          commandmode = 4;
          memset(temp_leddata, 0, 3);
          ledscheme = 8;
          message += "Red Value (0-255) =\n";
        }
        if (command == "screenedit") { //Edit the screen scheme
          commandmode = 7;
          memset(temp_screendata, 0xFF, element);
          screenscheme = 5;
          message += "Screen Data Part.1 =\n";
        }
        break;

      case 1: //Effect scheme setting
        commandmode = 0;
        effectscheme = atoi(incomingPacket);
        if (effectscheme < 0 || effectscheme > 13 ) {
          effectscheme = 0;
        }
        message += "Effect Scheme => ";
        itoa(effectscheme, tmp, 10);
        message += tmp;
        message += "\n\n";
        break;

      case 2: //LED scheme Setting
        commandmode = 0;
        ledscheme = atoi(incomingPacket);
        if (ledscheme < 0 || ledscheme > 8 ) {
          ledscheme = 0;
        }
        message += "LED Scheme => ";
        itoa(ledscheme, tmp, 10);
        message += tmp;
        message += "\n\n";
        break;

      case 3: //Screen scheme Setting
        commandmode = 0;
        screenscheme = atoi(incomingPacket);
        if (screenscheme < 0 || screenscheme > 5 ) {
          screenscheme = 0;
        }
        message += "Screen Scheme => ";
        itoa(screenscheme, tmp, 10);
        message += tmp;
        message += "\n\n";
        break;

      case 4:
        commandmode = 5;
        temp_leddata[0] = atoi(incomingPacket);
        if (temp_leddata[0] < 0 || temp_leddata[0] > 255 ) {
          temp_leddata[0] = 0;
        }
        message += "Green Value (0-255) =\n";
        break;

      case 5:
        commandmode = 6;
        temp_leddata[1] = atoi(incomingPacket);
        if (temp_leddata[1] < 0 || temp_leddata[1] > 255 ) {
          temp_leddata[1] = 0;
        }
        message += "Blue Value (0-255) =\n";
        break;

      case 6:
        commandmode = 0;
        temp_leddata[2] = atoi(incomingPacket);
        if (temp_leddata[2] < 0 || temp_leddata[2] > 255 ) {
          temp_leddata[2] = 0;
        }
        message += "Red => ";
        itoa(temp_leddata[0], tmp, 10);
        message += tmp;
        message += " , Green => ";
        itoa(temp_leddata[1], tmp, 10);
        message += tmp;
        message += " , Blue => ";
        itoa(temp_leddata[2], tmp, 10);
        message += tmp;
        message += "\n\n";
        break;

      case 7:
        commandmode = 8;
        for (i = 0; i < element / 2 * 2; i += 2) {
          tmp[0] = incomingPacket[i];
          tmp[1] = incomingPacket[i + 1];
          tmp[2] = 0;
          temp_screendata[i / 2] = (int)strtol(tmp, NULL, 16);
        }
        message += "Screen Data Part.2 =\n";
        break;

      case 8:
        commandmode = 0;
        for (i = 0; i < element / 2 * 2; i += 2) {
          tmp[0] = incomingPacket[i];
          tmp[1] = incomingPacket[i + 1];
          tmp[2] = 0;
          temp_screendata[element / 2 + i / 2] = (int)strtol(tmp, NULL, 16);
        }
        message += "Screen Data Updated\n\n";
        break;
    }
    char* buf = (char*) malloc(sizeof(char) * message.length() + 1);
    message.toCharArray(buf, message.length() + 1);
    Udp.beginPacket(Udp.remoteIP(), Udp.remotePort());
    Udp.write(buf);
    Udp.endPacket();
  }
}

void comhandler() {
  String comdata;
  if (Serial.available() > 0) {
    comdata = Serial.readString();
    if (comdata == "info") {
      infomaker(1);
    }
    comdata = "";
  }
}

void infomaker(int x) {
  char tmp[32];
  String message = "Smart POV-LED Status Panel\n"; //Start of headline
  message += "Version: ";
  message += ver;
  message += "\n";
  message += "Developed by: Xu Ruoyang, Nie Hongtuo, Xu Yao @UESTC\n"; //End of headline
  message += "\n";
  message += "Hardware Information:\n"; //Start of hardware information
  message += " Module Voltage: ";
  itoa(ESP.getVcc(), tmp, 10);
  message += tmp;
  message += " mV\n";
  message += " Running Time: ";
  itoa(millis() / 1000, tmp, 10);
  message += tmp;
  message += " seconds\n";
  message += " Cycle Number: ";
  itoa(cycle, tmp, 10);
  message += tmp;
  message += "\n";
  message += " Motor Speed: ";
  itoa(rpm, tmp, 10);
  message += tmp;
  message += " RPM\n"; //End of hardware information
  message += "\n";
  message += "Network Information:\n"; //Start of Wi-Fi information
  if (WiFi.status() == WL_CONNECTED) {
    message += " Wi-Fi: Connected\n";
    message += " SoftAP: OFF\n";
    message += " SSID: ";
    message += ssid;
    message += "\n";
    message += " IP Address: ";
    message += WiFi.localIP().toString().c_str();
    message += "\n";

  } else {
    message += " Wi-Fi: Disconnected\n";
    message += " SoftAP: ON\n";
    message += " SoftAP SSID: ";
    message += apssid;
    message += "\n";
    message += " IP Address: ";
    message += WiFi.softAPIP().toString().c_str();
    message += "\n";
  }
  message += " Web Server Port: 80\n";
  message += " UDP Port: ";
  itoa(localUdpPort, tmp, 10);
  message += tmp;
  message += "\n"; //End of Wi-Fi information
  message += "\n";
  message += "Display Information:\n"; //Start of display information
  message += " Status:\n";
  if (checkstat() == true) {
    message += "  Playing\n";
  } else {
    message += "  Stopped for some reasons\n";
  }
  message += " Effect:\n";
  message += "  Scheme: ";
  itoa(effectscheme, tmp, 10);
  message += tmp;
  message += "\n";
  message += " LED:\n";
  message += "  Scheme: ";
  itoa(ledscheme, tmp, 10);
  message += tmp;
  message += "\n";
  message += "  Red: ";
  if (ledscheme < 8) { //Choose saved data
    itoa(saved_leddata[ledscheme][0], tmp, 10);
  } else { //Choose temporary data
    itoa(temp_leddata[0], tmp, 10);
  }
  message += tmp;
  message += "\n";
  message += "  Green: ";
  if (ledscheme < 8) { //Choose saved data
    itoa(saved_leddata[ledscheme][1], tmp, 10);
  } else { //Choose temporary data
    itoa(temp_leddata[1], tmp, 10);
  }
  message += tmp;
  message += "\n";
  message += "  Blue: ";
  if (ledscheme < 8) { //Choose saved data
    itoa(saved_leddata[ledscheme][2], tmp, 10);
  } else { //Choose temporary data
    itoa(temp_leddata[2], tmp, 10);
  }
  message += tmp;
  message += "\n";
  message += " Screen:\n";
  message += "  Scheme: ";
  itoa(screenscheme, tmp, 10);
  message += tmp;
  message += "\n";
  message += "  Size: 128 x 64\n";
  message += "  Data:\n";
  switch (x) {
    case 0:
      convertscreen(&message);
      break;

    case 1:
      message += "   <Not supported in Serial Mode>\n";
      break;

    case 2:
      message += "   <Not supported in UDP Mode>\n";
      break;
  }
  message += "\n"; //End of display information
  switch (x) {
    case 0:
      server.send(200, "text/plain", message);
      break;

    case 1:
      Serial.print(message);
      break;

    case 2:
      char* buf = (char*) malloc(sizeof(char) * message.length() + 1);
      message.toCharArray(buf, message.length() + 1);
      Udp.beginPacket(Udp.remoteIP(), Udp.remotePort());
      Udp.write(buf);
      Udp.endPacket();
      break;
  }
}

void convertscreen(String *msg) {
  int i, j, k, l;
  char datatmp;
  for (i = 0; i < 8; i++) {
    for (j = 1; j <= 8; j++) {
      *msg += "   ";
      for (k = 0; k < element - 1; k += 8) {
        if (screenscheme < 5) { //Choose saved data
          datatmp = saved_screendata[screenscheme][i + k];
        } else { //Choose temporary data
          datatmp = temp_screendata[i + k];
        }
        for (l = 1; l < j; l++) {
          datatmp /= 2;
        }
        if (datatmp % 2 == 0) {
          *msg += "X";
        } else {
          *msg += " ";
        }
      }
      *msg += "\n";
    }
  }
}

void ledcontrol() {
  if (ledscheme < 8) { //Choose saved data
    analogWrite(rPin, saved_leddata[ledscheme][0]); //Set Red Pin
    analogWrite(gPin, saved_leddata[ledscheme][1]); //Set Green Pin
    analogWrite(bPin, saved_leddata[ledscheme][2]); //Set Blue Pin
  } else { //Choose temporary data
    analogWrite(rPin, temp_leddata[0]); //Set Red Pin
    analogWrite(gPin, temp_leddata[1]); //Set Green Pin
    analogWrite(bPin, temp_leddata[2]); //Set Blue Pin
  }
}

void screencontrol() {
  int i, j, k;
  int real;
  for (i = 0; i < element - 1; i += 8) { //Loop in 128 rows
    if (homeflag) { //Detect home flag
      homeflag = false;
      cycle++;
      i = 0; //Reset screen data
    }
    digitalWrite(latchPin, LOW);
    for (j = 0; j < 8; j++) {
      switch (effectscheme) {
        case 0: //Effect 0: Normal
          real = i + j;
          break;

        case 1: //Effect 1: Mirror
          real = element - i + j;
          break;

        case 2: //Effect 2: Clockwise
          k = 8 * (cycle / 10) % (element / 8);
          real = (1024 + i + j - k) % element;
          break;

        case 3: //Effect 3: Anticlockwise
          k = 8 * (cycle / 10) % (element / 8);
          real = (i + j + k) % element;
          break;

        case 4: //Effect 4: Half Clockwise, Half Anticlockwise
          k = 8 * (cycle / 10) % (element / 8);
          if (k < 4) {
            real = (1024 + i + j - k) % element;
          } else {
            real = (i + j + k) % element;
          }
          break;

        case 5: //Effect 5: Half Anticlockwise, Half Clockwise
          k = 8 * (cycle / 10) % (element / 8);
          if (k >= 4) {
            real = (1024 + i + j - k) % element;
          } else {
            real = (i + j + k) % element;
          }
          break;

        case 6: //Effect 6: Edge Clockwise, Center Anticlockwise
          k = 8 * (cycle / 10) % (element / 8);
          if (k < 2 || k > 5) {
            real = (1024 + i + j - k) % element;
          } else {
            real = (i + j + k) % element;
          }
          break;

        case 7: //Effect 7: Edge Anticlockwise, Center Clockwise
          k = 8 * (cycle / 10) % (element / 8);
          if (k >= 2 && k <= 5) {
            real = (1024 + i + j - k) % element;
          } else {
            real = (i + j + k) % element;
          }
          break;

        case 8: //Effect 8: Edge Clockwise, Center Freeze
          k = 8 * (cycle / 10) % (element / 8);
          if (k < 2 || k > 5) {
            real = (1024 + i + j - k) % element;
          } else {
            real = i + j;
          }
          break;

        case 9: //Effect 9: Edge Anticlockwise, Center Freeze
          k = 8 * (cycle / 10) % (element / 8);
          if (k < 2 || k > 5) {
            real = (i + j + k) % element;
          } else {
            real = i + j;
          }
          break;

        case 10: //Effect 10: Edge 1 Clockwise, Center Freeze, Edge 2 Anticlockwise
          k = 8 * (cycle / 10) % (element / 8);
          if (k < 2) {
            real = (1024 + i + j - k) % element;
          } else if (k > 5) {
            real = (i + j + k) % element;
          } else {
            real = i + j;
          }
          break;

        case 11: //Effect 11: Edge 1 Anticlockwise, Center Freeze, Edge 2 Clockwise
          k = 8 * (cycle / 10) % (element / 8);
          if (k > 5) {
            real = (1024 + i + j - k) % element;
          } else if (k < 2) {
            real = (i + j + k) % element;
          } else {
            real = i + j;
          }
          break;

        case 12: //Effect 12: Edge Freeze, Center Clockwise
          k = 8 * (cycle / 10) % (element / 8);
          if (k < 2 || k > 5) {
            real = (1024 + i + j - k) % element;
          } else {
            real = i + j;
          }
          break;

        case 13: //Effect 13: Edge Freeze, Center Anticlockwise
          k = 8 * (cycle / 10) % (element / 8);
          if (k < 2 || k > 5) {
            real = (i + j + k) % element;
          } else {
            real = i + j;
          }
          break;
      }
      if (screenscheme < 5) { //Choose saved data
        shiftOut(dataPin, clockPin, MSBFIRST, saved_screendata[screenscheme][real]); //Send data to 74HC595
      } else { //Choose temporary data
        shiftOut(dataPin, clockPin, MSBFIRST, temp_screendata[real]); //Send data to 74HC595
      }
    }
    digitalWrite(latchPin, HIGH); //Return the latch pin high to signal chip that it no longer needs to listen for information
    if (rpm >= 600) {
      delayMicroseconds(6E7 / rpm / (element / 8)); //Calculate the interval
    }
  }
}

